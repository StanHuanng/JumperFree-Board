/*--------------------------------------------------------------------------------
 * 项目名称:

     S51初级版中断按键测试程序 V1.0.0

 * 功能描述:

     通过外部中断0和外部中断1按键控制流水灯闪烁

 * 版权信息:

     (c) 飞翼电子, 2012.

 * 历史版本:
     2012-06-30:
       - 初始版本 V1.0.0;

 * 配置说明:
     MCU:             AT89S51
     开发板:       	  AT89S51初级板 V1.0
                      http://www.mikroe.com/en/tools/bigavr6/
     晶振:      	  外部晶振：11.0592MHz
     扩展模块:  	  -
     软件:            Keil.C51.V9.01

 * 备注:
     - 确认开发板P6跳线上连接了短路子
-------------------------------------------------------------------------------------*/
/************************包含头文件***************************************************/

#include<reg52.h>

/************************函数声明****************************************************/

void DelayFun(unsigned char m);	 				//延时函数声明

/************************定义全局变量*************************************************/

unsigned char* p=0;								//定义全局指针变量
unsigned char arr[4]={0xfe,0xfd,0xfb,0xf7};		//定义全局数组，控制指示灯的显示

/************************主函数******************************************************/
void  main()
{
	unsigned char cycleControl=0; 				//控制流水灯的循环						
	unsigned char state=0;						//设置流水灯的状态：0——循环，1——暂停

	p=&state;  									//全局指针指向state变量

	EA=1;										//使能全局中断
	IT0=0;										//设置外部中断0为边沿触发方式
	EX0=1;										//使能外部中断0
	IT1=0;										//设置设置外部中断1为边沿触发方式
	EX1=1;										//使能外部中断1


	while(1)
	{
		switch (state)
		{
			case 0:								/*循环模式*/
			{
				if(cycleControl==4)
				{
					cycleControl=0;
				}
				P0=arr[cycleControl];		//查询数组，设置P0端口的输出
				cycleControl++;
				DelayFun(1);	//延时，设置闪烁频率
				break;
			}							  		/*暂停*/
			default:
			{
				;				//在触发时刻流水灯暂停
			}
		}
	}
}


/**************************中断服务程序******************************************/
void ExINT0() interrupt 0	  //外部中断1，触发时，流水灯继续
{
	EX1=0;
	*p=0;
	EX1=1;
}

void ExINT1() interrupt 2	  //外部中断1，触发时，流水灯暂停
{
	EX0=0;
	*p=1;
	EX0=1;
}
/**************************延时子函数********************************************/

void DelayFun(unsigned char m)
{ 				
	unsigned char i=0,j=0,k=0;

	for(k=0;k<m;k++)
		for(i=0;i<255;i++)
			for(j=0;j<255;j++)
			{
				;
			}
}

/*********************************The End****************************************/
