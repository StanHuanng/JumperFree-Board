/*------------------------------------------------------------------------------------
 * 项目名称:

     RGB LED 光环测试程序

 * 功能描述:

	 RGB三色循环覆盖

 * 版权信息:

     (c) 飞翼电子, 2014.

 * 历史版本:
     2014-03-7:
       - 初始版本 V1.0.0;

 * 配置说明:
 	 - MCU    ：STC15W204S
	 - CPU频率：33MHz
-------------------------------------------------------------------------------------*/

#define Port P3

/************************包含头文件***************************************************/

#include "STC15W.h"
#include "ws2812.h"		 //包含LED驱动程序
#include "delay.h"		 //包含延时程序
#include "keypad.h"		 //包含按键驱动程序

/************************主程序*******************************************************/

void  main()
{
	unsigned char i;
	unsigned char s[27][3]={{50,5,5},{50,5,5},{50,5,5},{50,5,5},{50,5,5},{50,5,5},
	{50,5,5},{50,5,5}};	//定义一个二维，每个括号内的三个数据对应一个像素点

	DelayMs(200);					//上电等待延时

	Port=0xff;						//初始化端口为高电平

	while(1)
	{
		for(i=0;i<8;i++)
		{
			s[i][0]=5;		    	//修改数组中的数据
			s[i][1]=50;
			s[i][2]=5;

			SendOneFrame(s);		//显示数组中的数据
			Delay100Ms(1);
		}

		for(i=0;i<8;i++)
		{
			s[i][0]=5;
			s[i][1]=5;
			s[i][2]=50;

			SendOneFrame(s);
			Delay100Ms(1);
		}
		for(i=0;i<8;i++)
		{
			s[i][0]=50;
			s[i][1]=5;
			s[i][2]=5;

			SendOneFrame(s);
			Delay100Ms(1);
		}
	}
}




/************************结束*******************************************************/
