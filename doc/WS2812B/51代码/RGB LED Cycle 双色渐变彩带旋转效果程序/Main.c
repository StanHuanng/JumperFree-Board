/*------------------------------------------------------------------------------------
 * 项目名称:

     RGB LED 测试程序

 * 功能描述:

	 双色渐变彩带旋转覆盖

 * 版权信息:

     (c) 飞翼电子, 2014.

 * 历史版本:
     2014-03-7:
       - 初始版本 V1.0.0;

 * 配置说明:
 	 - MCU    ：STC15W204S
	 - CPU频率：33MHz
-------------------------------------------------------------------------------------*/

#define Port P3

/************************包含头文件***************************************************/

#include "STC15W.h"
#include "ws2812.h"
#include "delay.h"
#include "keypad.h"

/************************主程序*******************************************************/

void  main()
{
	unsigned char i;
	unsigned char oneTimeFlag=0;	//控制某些语句只在第一循环时被执行
	unsigned char s[8][3]={{50,5,5},{50,5,5},{50,5,5},{50,5,5},{50,5,5},{50,5,5},
	{50,5,5},{50,5,5}};	//定义一个二维，每个括号内的三个数据对应一个像素点

	DelayMs(200);					//上电等待延时

	Port=0xff;						//初始化端口为高电平

	while(1)
	{
		if(oneTimeFlag==0)			//修改数组中的数据，只在第一次执行到时执行
		{
			for(i=0;i<8;i++)	    
			{
				s[i][0]=128-(i<<4);
				s[i][1]=5+(i<<4);
				s[i][2]=5;
			}
			oneTimeFlag=1;
		}
		for(i=0;i<8;i++)
		{					
			SendOneFrameFrom(i,s);	//从低i个像素点显示数组的数据
			DelayMs(40);
		}
	}
}




/************************结束*******************************************************/
